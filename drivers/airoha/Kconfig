## drivers/input/fingerprint/Kconfig
```kconfig
#
# Fingerprint sensor configuration
#
menuconfig INPUT_FINGERPRINT
	bool "Fingerprint sensors"
	help
	  Say Y here, and a list of supported fingerprint sensors will be displayed.
	  This option doesn't affect the kernel.

	  If unsure, say N.

if INPUT_FINGERPRINT

source "drivers/input/fingerprint/fpc_fod/Kconfig"
source "drivers/input/fingerprint/fpc_tee/Kconfig"
source "drivers/input/fingerprint/goodix/Kconfig"
source "drivers/input/fingerprint/goodix_fod/Kconfig"

endif
```

## drivers/input/touchscreen/fts_spi/Kconfig
```kconfig
config TOUCHSCREEN_ST_FTS_V521_SPI
	tristate "ST FTS V521 I2C Touchscreen"
	depends on I2C
	help
	  Say Y here if you have ST FTS series I2C touchscreen.

	  If unsure, say N.

	  To compile this driver as a module, choose M here: the


config FTS_FOD_AREA_REPORT
        tristate "FTS FOD area report"
        depends on TOUCHSCREEN_ST_FTS_V521_SPI
        help
          Say Y here to enable fod area report functionality.

          If unsure, say N.
```

## drivers/platform/xiaomi/Kconfig
```kconfig
# Xiaomi configuration options

config MACH_XIAOMI
	bool "Xiaomi device"
	depends on ARCH_QCOM
	help
	  Support for Xiaomi products

config MACH_XIAOMI_SM8250
	bool "Xiaomi SM8250"
	depends on ARCH_QCOM
	select MACH_XIAOMI
	help
	  Support for Xiaomi SM8250 devices

menu "Xiaomi board selection"

	config MACH_XIAOMI_ALIOTH
		bool "Xiaomi alioth board"
		select MACH_XIAOMI_SM8250
		help
		  Support for Redmi K40 / POCO F3 / Mi 11X

	config MACH_XIAOMI_APOLLO
		bool "Xiaomi apollo board"
		select MACH_XIAOMI_SM8250
		help
		  Support for Mi 10T / Mi 10T Pro / Redmi K30S Ultra

	config MACH_XIAOMI_CAS
		bool "Xiaomi cas board"
		select MACH_XIAOMI_SM8250
		help
		  Support for Mi 10 Ultra

	config MACH_XIAOMI_CMI
		bool "Xiaomi cmi board"
		select MACH_XIAOMI_SM8250
		help
		  Support for Mi 10 Pro

	config MACH_XIAOMI_DAGU
		bool "Xiaomi dagu board"
		select MACH_XIAOMI_SM8250
		help
		  Support for Xiaomi Pad 5 Pro 12.4

	config MACH_XIAOMI_ELISH
		bool "Xiaomi elish board"
		select MACH_XIAOMI_SM8250
		help
		  Support for Xiaomi Pad 5 Pro Wi-Fi

	config MACH_XIAOMI_ENUMA
		bool "Xiaomi enuma board"
		select MACH_XIAOMI_SM8250
		help
		  Support for Xiaomi Pad 5 Pro 5G

	config MACH_XIAOMI_LMI
		bool "Xiaomi lmi board"
		select MACH_XIAOMI_SM8250
		help
		  Support for Redmi K30 Pro / POCO F2 Pro

	config MACH_XIAOMI_MUNCH
		bool "Xiaomi munch board"
		select MACH_XIAOMI_SM8250
		help
		  Support for Redmi K40S / POCO F4

	config MACH_XIAOMI_PSYCHE
		bool "Xiaomi psyche board"
		select MACH_XIAOMI_SM8250
		help
		  Support for Xiaomi 12X

	config MACH_XIAOMI_THYME
		bool "Xiaomi thyme board"
		select MACH_XIAOMI_SM8250
		help
		  Support for Mi 10S

	config MACH_XIAOMI_UMI
		bool "Xiaomi umi board"
		select MACH_XIAOMI_SM8250
		help
		  Support for Mi 10

endmenu
```

## drivers/xiaomi/Kconfig
```kconfig
menu "Xiaomi MIUI additions"

config XIAOMI_MIUI
	bool "Enable Xiaomi MIUI modifications"
	depends on BOARD_XIAOMI
	help
	  Enables compilation of Xiaomi MIUI specific vendor additions

	  Say Y if you want to compile the Xiaomi MIUI specific kernel modifications.
	  Say N if you want to discard the Xiaomi MIUI specific kernel modifications.

if XIAOMI_MIUI

config MIGT
	bool "Boost cpufreq during high load"
	help
	  Boost cpufreq when current frame drawing time too long

config MILLET
	bool "MIUI frozen framework"
	help
	  MIUI frozen function

config MIGT_ENERGY_MODEL
	bool "DT-based Energy Model for CPU and GPU"
	help
	  This mod rely on Energy Models (EMs) statically defined in
	  the Device Tree. Since EAS now uses only the active costs of CPUs,
	  the cluster-related costs and idle-costs are ignored.

config PACKAGE_RUNTIME_INFO
	bool "Show package runtime info on cluster"
	help
	  This option can show package runtime info in sup/big/little core.

config PERF_HUMANTASK
	bool "Enable MIUI humantask performance feature"
	help
	  This option adds support to switch on/off the sched humantask.

config PERF_CRITICAL_RT_TASK
	bool "Enable set rt binder thread" if EXPERT
	help
	  This option speeds ui feature by setting BlastBufferQueue binder
	  thread to FIFO.

config SF_BINDER
	bool "Enable surfaceflinger binder thread" if EXPERT
	help
	  Xiaomi restore surfaceflinger binder priority FIFO

endif

endmenu
```

## drivers/xiaomi/fragmention/Kconfig
```kconfig
config MI_FRAGMENTION
	bool "Xiaomi memory fragmention test"
	help
	  Say Y to enable MIUI Memory fragmentize simulate test
```

## net/sla/Kconfig
```kconfig
menu "SLA Configuration"
	depends on NET && INET && NETFILTER

config SLA_STAIC_COLLECT
	tristate "SLA Statistics collector"
	depends on NETFILTER
	default y if BOARD_XIAOMI
	---help---
	  QTI Smart Link Aggregation for Web Browsing

endmenu
```

## techpack/Kconfig
```kconfig
menu "Tech packages"

source "techpack/data/Kconfig"

menu "Camera packages"

config TECHPACK_CAMERA_XIAOMI
    bool "Xiaomi camera"
    help
      Xiaomi camera

config TECHPACK_CAMERA_XIAOMI_PSYCHE
    bool "Xiaomi camera psyche"
    help
      Xiaomi camera psyche

config TECHPACK_CAMERA_XIAOMI_CAS
    bool "Xiaomi camera CAS"
    help
      Xiaomi camera CAS

config TECHPACK_CAMERA_XIAOMI_TABLET
    bool "Xiaomi camera tablet"
    help
      Xiaomi camera tablet

endmenu

endmenu
```
