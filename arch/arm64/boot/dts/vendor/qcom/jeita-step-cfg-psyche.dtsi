/* Copyright (c) 2018-2019, The Linux Foundation. All rights reserved.
 *
 * This program is free software; you can redistribute it and/or modify
 * it under the terms of the GNU General Public License version 2 and
 * only version 2 as published by the Free Software Foundation.
 *
 * This program is distributed in the hope that it will be useful,
 * but WITHOUT ANY WARRANTY; without even the implied warranty of
 * MERCHANTABILITY or FITNESS FOR A PARTICULAR PURPOSE.  See the
 * GNU General Public License for more details.
 */

qcom,psyche {
	/* j1 jeita, step charge and other important charging parameters */
	qcom,fastchg-current-ma = <12300>;
	qcom,jeita-fcc-ranges = <(-100)  0  900000
				1  50    2150000
				51  100  3050000
				101 150  5250000
				151 480  12300000
				481 580  2150000>;
	qcom,jeita-fv-ranges = <(-100)  0   4480000
				1   50   4480000
				51  100  4480000
				101 150  4480000
				151 480  4540000
				481 580  4090000>;
	qcom,step-chg-ranges = <3000000  3349000  1000000
				3350000  4250000  12300000
				4251000  4350000  6600000
				4351000  4480000  5720000
				4481000  4540000  4400000>;
	qcom,step-chg-high-cc-ranges = <3000000  3349000  1000000
				3350000  4200000  12300000
				4201000  4350000  6600000
				4351000  4480000  5720000
				4481000  4540000  4400000>;
	qcom,cold-step-chg-ranges = <3000000  4199000  950000
				4200000  4480000  650000>;
	qcom,jeita-too-hot = <580>;
	qcom,jeita-too-cold = <(-100)>;
	qcom,jeita-warm-th= <480>;
	qcom,jeita-cool-th= <150>;
	qcom,ocv-based-step-chg;
	qcom,taper-fcc;
	qcom,use-bq-pump;
	qcom,use-ext-gauge;
	qcom,max-voltage-uv = <4540000>;
	qcom,batt-id-kohm = <100>;
	qcom,battery-type = "L3A_profile";
};
