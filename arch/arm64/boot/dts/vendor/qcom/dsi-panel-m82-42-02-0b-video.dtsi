/* Copyright (c) 2015, The Linux Foundation. All rights reserved.
 *
 * This program is free software; you can redistribute it and/or modify
 * it under the terms of the GNU General Public License version 2 and
 * only version 2 as published by the Free Software Foundation.
 *
 * This program is distributed in the hope that it will be useful,
 * but WITHOUT ANY WARRANTY; without even the implied warranty of
 * MERCHANTABILITY or FITNESS FOR A PARTICULAR PURPOSE.  See the
 * GNU General Public License for more details.
 */

/*---------------------------------------------------------------------------
 * This file is autogenerated file using gcdb parser. Please do not edit it.
 * Update input XML file to add a new entry or update variable in this file
 * VERSION = "1.0"
 *---------------------------------------------------------------------------*/
&mdss_mdp {
    dsi_m82_42_02_0b_dual_dphy_video: qcom,mdss_dsi_m82_42_02_0b_dual_dphy_video {
        qcom,mdss-dsi-panel-name = "xiaomi m82 42 02 0b video mode dual dsi dphy panel";
        qcom,mdss-dsi-panel-id = <0>;
        qcom,mdss-dsi-panel-model = "xiaomi 42 02 0b VIDEO PANEL";
        qcom,mdss-dsi-panel-type = "dsi_video_mode";
        qcom,mdss-dsi-panel-count = <2>;
        qcom,mdss-dsi-stream = <0>;
        qcom,mdss-dsi-bpp = <24>;
        qcom,mdss-dsi-underflow-color = <0xff>;
        qcom,mdss-dsi-border-color = <0>;
        qcom,mdss-dsi-traffic-mode = "non_burst_sync_event";
        qcom,mdss-dsi-bllp-eof-power-mode;
        qcom,mdss-dsi-bllp-power-mode;
        qcom,mdss-dsi-pixel-packing = "loose";
        qcom,mdss-dsi-lp11-init;
        qcom,mdss-dsi-virtual-channel-id = <0>;
        qcom,mdss-dsi-color-order = "rgb_swap_rgb";
        qcom,mdss-dsi-lane-0-state;
        qcom,mdss-dsi-lane-1-state;
        qcom,mdss-dsi-lane-2-state;
        qcom,mdss-dsi-lane-3-state;
        qcom,mdss-dsi-interleave-mode = <0>;
        mi,mdss-dsi-fac-bl-max-level = <2047>;
        mi,mdss-fac-brightness-max-level = <2047>;
        mi,mdss-dsi-panel-max-brightness-clone = <4095>;
        qcom,mdss-dsi-dma-trigger = "trigger_sw";
        qcom,mdss-dsi-mdp-trigger = "none";
        qcom,mdss-dsi-reset-sequence = <0 10>, <1 3>, <0 3>, <1 15>;
        qcom,adjust-timer-wakeup-ms = <1>;
        qcom,mdss-pan-physical-width-dimension = <1480>;
        qcom,mdss-pan-physical-height-dimension = <2367>;
        qcom,mdss-dsi-panel-mode-gpio-state = "invalid";
        qcom,mdss-dsi-tx-eot-append;
        qcom,mdss-dsi-rx-eot-ignore;

        qcom,cmd-sync-wait-broadcast;
        qcom,mdss-dsi-panel-broadcast-mode;

        // qcom,esd-check-enabled;
        qcom,mdss-dsi-panel-status-check-mode ="irq_check";
        qcom,mdss-dsi-panel-status-command = [06 01 00 00 00 00 01 0A];
        qcom,mdss-dsi-panel-status-command-state = "dsi_lp_mode";
        qcom,mdss-dsi-panel-status-value = <0x9D>;
        qcom,mdss-dsi-panel-status-read-length = <1>;

        qcom,bl-update-flag = "delay_until_first_frame";
        qcom,mdss-dsi-phy-voltage = <0x51>;
        qcom,mdss-dsi-panel-hdr-enabled;
        qcom,mdss-dsi-panel-hdr-color-primaries = <14500 15500 32000
            17000 15500 30000 8000 3000>;
        qcom,mdss-dsi-panel-peak-brightness = <4200000>;
        qcom,mdss-dsi-panel-blackness-level = <3230>;

       qcom,mdss-dsi-pan-enable-dynamic-fps;
      qcom,mdss-dsi-pan-fps-update =
               "dfps_immediate_porch_mode_vfp";
       qcom,dsi-supported-dfps-list = <120 144 90 60 50 48 30>;

        qcom,mdss-dsi-display-timings {
            timing@0{
                qcom,mdss-dsi-panel-framerate = <120>;
                qcom,mdss-dsi-panel-width = <900>; // 1600/2
                qcom,mdss-dsi-panel-height = <2880>;
                qcom,mdss-dsi-h-pulse-width = <2>;
                qcom,mdss-dsi-h-back-porch = <46>;
                qcom,mdss-dsi-h-front-porch = <100>;
                qcom,mdss-dsi-h-sync-skew = <0>;
                qcom,mdss-dsi-v-pulse-width = <2>;
                qcom,mdss-dsi-v-back-porch = <214>;
                qcom,mdss-dsi-v-front-porch = <26>;
                qcom,mdss-dsi-h-left-border = <0>;
                qcom,mdss-dsi-h-right-border = <0>;
                qcom,mdss-dsi-v-top-border = <0>;
                qcom,mdss-dsi-v-bottom-border = <0>;
                qcom,mdss-dsi-panel-clockrate = <1007032320>;

                qcom,mdss-dsi-on-command= [
                        //ESD init
                        39 01 00 00 00 00 02 FF 27
                        39 01 00 00 00 00 02 FB 01
                        39 01 00 00 00 00 02 D0 31
                        39 01 00 00 00 00 02 D1 20
                        39 01 00 00 00 00 02 D2 38
                        39 01 00 00 00 00 02 DE 43
                        39 01 00 00 00 00 02 DF 02
                        //CABC start
                        39 01 00 00 00 00 02 FF 23
                        39 01 00 00 00 00 02 FB 01
                        //PWM 12bit
                        39 01 00 00 00 00 02 00 80
                        //dimming enable
                        39 01 00 00 00 00 02 01 84
                        39 01 00 00 00 00 02 05 2D
                        39 01 00 00 00 00 02 06 00
                        //PWM frequency 12bit default 11.7Khz
                        //resolution 1800*2880
                        39 01 00 00 00 00 02 11 03
                        39 01 00 00 00 00 02 12 2A
                        39 01 00 00 00 00 02 15 D0
                        39 01 00 00 00 00 02 16 16
                        //UI mode
                        39 01 00 00 00 00 02 29 0A
                        39 01 00 00 00 00 02 30 FF
                        39 01 00 00 00 00 02 31 FE
                        39 01 00 00 00 00 02 32 FD
                        39 01 00 00 00 00 02 33 FB
                        39 01 00 00 00 00 02 34 F8
                        39 01 00 00 00 00 02 35 F5
                        39 01 00 00 00 00 02 36 F3
                        39 01 00 00 00 00 02 37 F2
                        39 01 00 00 00 00 02 38 F2
                        39 01 00 00 00 00 02 39 F2
                        39 01 00 00 00 00 02 3A EF
                        39 01 00 00 00 00 02 3B EC
                        39 01 00 00 00 00 02 3D E9
                        39 01 00 00 00 00 02 3F E5
                        39 01 00 00 00 00 02 40 E5
                        39 01 00 00 00 00 02 41 E5
                        //STILL mode
                        39 01 00 00 00 00 02 2A 13
                        39 01 00 00 00 00 02 45 FF
                        39 01 00 00 00 00 02 46 F4
                        39 01 00 00 00 00 02 47 E7
                        39 01 00 00 00 00 02 48 DA
                        39 01 00 00 00 00 02 49 CD
                        39 01 00 00 00 00 02 4A C0
                        39 01 00 00 00 00 02 4B B3
                        39 01 00 00 00 00 02 4C B1
                        39 01 00 00 00 00 02 4D B1
                        39 01 00 00 00 00 02 4E B1
                        39 01 00 00 00 00 02 4F 95
                        39 01 00 00 00 00 02 50 79
                        39 01 00 00 00 00 02 51 5C
                        39 01 00 00 00 00 02 52 58
                        39 01 00 00 00 00 02 53 58
                        39 01 00 00 00 00 02 54 58
                        //MOVING mode
                        39 01 00 00 00 00 02 2B 0E
                        39 01 00 00 00 00 02 58 FF
                        39 01 00 00 00 00 02 59 FB
                        39 01 00 00 00 00 02 5A F7
                        39 01 00 00 00 00 02 5B F3
                        39 01 00 00 00 00 02 5C EF
                        39 01 00 00 00 00 02 5D E3
                        39 01 00 00 00 00 02 5E D8
                        39 01 00 00 00 00 02 5F D6
                        39 01 00 00 00 00 02 60 D6
                        39 01 00 00 00 00 02 61 D6
                        39 01 00 00 00 00 02 62 C8
                        39 01 00 00 00 00 02 63 B7
                        39 01 00 00 00 00 02 64 AA
                        39 01 00 00 00 00 02 65 A8
                        39 01 00 00 00 00 02 66 A8
                        39 01 00 00 00 00 02 67 A8
                        // ------Initial Code Update_c13------(start)
                        39 01 00 00 00 00 02 FF 20
                        39 01 00 00 00 00 02 FB 01
                        39 01 00 00 00 00 02 17 02
                        //VDDI_LVD=1.3V
                        39 01 00 00 00 00 02 32 72

                        39 01 00 00 00 00 02 FF 22
                        39 01 00 00 00 00 02 FB 01
                        39 01 00 00 00 00 02 9F 57
                        39 01 00 00 00 00 05 B0 1F 1F 1F 1F
                        39 01 00 00 00 00 05 B1 4D 4D 4D 4D
                        39 01 00 00 00 00 05 B2 1E 1E 1E 1E
                        39 01 00 00 00 00 05 B3 6C 6C 6C 6C
                        39 01 00 00 00 00 05 B4 1F 1F 1F 1F
                        39 01 00 00 00 00 05 B5 44 44 44 44
                        39 01 00 00 00 00 02 B8 00
                        39 01 00 00 00 00 02 B9 6E
                        39 01 00 00 00 00 02 BA 6E
                        39 01 00 00 00 00 02 BB 6E
                        39 01 00 00 00 00 02 BE 0B
                        39 01 00 00 00 00 02 BF 6E
                        39 01 00 00 00 00 02 C1 6E
                        39 01 00 00 00 00 02 C3 6E

                        39 01 00 00 00 00 02 FF 23
                        39 01 00 00 00 00 02 FB 01
                        39 01 00 00 00 00 03 BA 7A 5D
                        39 01 00 00 00 00 03 BB 77 60

                        39 01 00 00 00 00 02 FF 24
                        39 01 00 00 00 00 02 FB 01
                        39 01 00 00 00 00 02 1C 80
                        39 01 00 00 00 00 04 92 45 00 C0
                        39 01 00 00 00 00 02 DB 33

                        39 01 00 00 00 00 02 FF 25
                        39 01 00 00 00 00 02 FB 01
                        39 01 00 00 00 00 02 05 00
                        39 01 00 00 00 00 02 23 09
                        39 01 00 00 00 00 02 24 16
                        39 01 00 00 00 00 02 2A 09
                        39 01 00 00 00 00 02 2B 16
                        39 01 00 00 00 00 02 42 0B
                        39 01 00 00 00 00 02 C5 1E
                        39 01 00 00 00 00 02 F6 02
                        39 01 00 00 00 00 02 F7 48

                        39 01 00 00 00 00 02 FF 26
                        39 01 00 00 00 00 02 FB 01
                        39 01 00 00 00 00 02 04 75
                        39 01 00 00 00 00 05 19 10 12 12 12
                        39 01 00 00 00 00 05 1A C5 A3 A3 A3
                        39 01 00 00 00 00 05 1B 0F 11 11 11
                        39 01 00 00 00 00 05 1C E8 C6 C6 C6
                        39 01 00 00 00 00 02 1E 45
                        39 01 00 00 00 00 02 1F 45
                        39 01 00 00 00 00 05 2A 10 12 12 12
                        39 01 00 00 00 00 05 2B C0 9E 9E 9E
                        39 01 00 00 00 00 02 2F 0B
                        39 01 00 00 00 00 02 30 45
                        39 01 00 00 00 00 02 32 45
                        39 01 00 00 00 00 02 33 22
                        39 01 00 00 00 00 02 34 92
                        39 01 00 00 00 00 02 35 78
                        39 01 00 00 00 00 02 36 96
                        39 01 00 00 00 00 02 37 78
                        39 01 00 00 00 00 02 38 06
                        39 01 00 00 00 00 02 3A 45
                        39 01 00 00 00 00 02 40 47
                        39 01 00 00 00 00 02 41 47
                        39 01 00 00 00 00 02 42 47
                        39 01 00 00 00 00 02 45 0B
                        39 01 00 00 00 00 02 46 47
                        39 01 00 00 00 00 02 48 47
                        39 01 00 00 00 00 02 4A 47
                        39 01 00 00 00 00 04 84 16 16 16
                        39 01 00 00 00 00 04 85 26 26 26
                        39 01 00 00 00 00 02 8B AA
                        39 01 00 00 00 00 05 99 26 26 26 26
                        39 01 00 00 00 00 05 9A B6 B6 B6 B6
                        39 01 00 00 00 00 05 9B 25 25 25 25
                        39 01 00 00 00 00 05 9C D4 D4 D4 D4
                        39 01 00 00 00 00 05 9D 26 26 26 26
                        39 01 00 00 00 00 05 9E AC AC AC AC

                        39 01 00 00 00 00 02 FF 27
                        39 01 00 00 00 00 02 FB 01
                        39 01 00 00 00 00 02 01 C1
                        39 01 00 00 00 00 02 07 01
                        39 01 00 00 00 00 03 08 3C 0D
                        39 01 00 00 00 00 03 0A EB 40
                        39 01 00 00 00 00 03 0C 4B 00
                        39 01 00 00 00 00 03 0E EB 40
                        39 01 00 00 00 00 03 10 4B 00
                        39 01 00 00 00 00 02 14 11
                        39 01 00 00 00 00 02 76 F0
                        39 01 00 00 00 00 02 77 02
                        39 01 00 00 00 00 02 79 29
                        39 01 00 00 00 00 02 7E 4E
                        39 01 00 00 00 00 03 80 C9 0C
                        39 01 00 00 00 00 03 81 3D 00
                        39 01 00 00 00 00 03 82 CB C0
                        39 01 00 00 00 00 03 84 92 00
                        39 01 00 00 00 00 03 85 36 00
                        39 01 00 00 00 00 03 86 CB C0
                        39 01 00 00 00 00 03 88 92 00

                        39 01 00 00 00 00 02 FF 2A
                        39 01 00 00 00 00 02 FB 01
                        39 01 00 00 00 00 02 14 09
                        39 01 00 00 00 00 02 1E 09
                        39 01 00 00 00 00 02 1F 09
                        39 01 00 00 00 00 02 A3 00
                        39 01 00 00 00 00 02 C5 09
                        39 01 00 00 00 00 02 C6 16
                        // ------Initial Code Update_c13------(end)
                        39 01 00 00 00 00 02 FF 10
                        39 01 00 00 00 00 02 FB 01
                        39 01 00 00 00 00 02 B3 40
                        39 01 00 00 00 00 02 B2 91
                        39 01 00 00 00 00 02 90 03
                        39 01 00 00 00 00 11 91 89 28 00 14 D2 00 01 F4 01 AB 00 06 05 7A 06 1A
                        39 01 00 00 00 00 03 92 10 F0
                        39 01 00 00 00 00 02 35 00
                        39 01 00 00 00 00 07 3B 03 D8 1A 0A 0A 00
                        39 01 00 00 00 00 03 51 0F FF
                        39 01 00 00 00 00 02 53 24
                        39 01 00 00 78 00 01 11
                        39 01 00 00 14 00 01 29
                        ];
                qcom,mdss-dsi-off-command = [
                        39 00 00 00 00 00 02 FF 27
                        39 01 00 00 00 00 02 D1 20
                        39 00 00 00 00 00 02 FF 10
                        05 01 00 00 00 00 02 28 00
                        05 01 00 00 78 00 02 10 00];
                qcom,mdss-dsi-displayoff-command = [05 01 00 00 20 00 02 28 00];
                qcom,mdss-dsi-displayon-command = [05 01 00 00 14 00 02 29 00];
                qcom,mdss-dsi-on-command-state = "dsi_lp_mode";
                qcom,mdss-dsi-off-command-state = "dsi_lp_mode";
                qcom,mdss-dsi-displayoff-command-state = "dsi_hs_mode";
                qcom,mdss-dsi-displayon-command-state = "dsi_hs_mode";

                qcom,compression-mode = "dsc";
                qcom,mdss-dsc-version = <0x11>;
                qcom,mdss-dsc-scr-version = <0x0>;
                qcom,mdss-dsc-slice-height = <20>;
                qcom,mdss-dsc-slice-width = <450>;
                qcom,mdss-dsc-slice-per-pkt = <2>;
                qcom,mdss-dsc-bit-per-component = <8>;
                qcom,mdss-dsc-bit-per-pixel = <8>;
                qcom,mdss-dsc-block-prediction-enable;
                mi,dsc-panel-id = <0x4D383241 0x00420200>;

                qcom,mdss-dsi-dispparam-pen-144hz-command = [
                        39 00 00 00 00 00 02 FF 10
                        39 00 00 00 00 00 02 FB 01
                        39 00 00 00 00 00 02 B3 00
                        39 01 00 00 00 00 02 B2 00
                        ];
                qcom,mdss-dsi-dispparam-pen-50hz-command = [
                        39 00 00 00 00 00 02 FF 10
                        39 00 00 00 00 00 02 FB 01
                        39 00 00 00 00 00 02 B3 80
                        39 01 00 00 00 00 02 B2 00
                        ];
                qcom,mdss-dsi-dispparam-pen-48hz-command = [
                        39 00 00 00 00 00 02 FF 10
                        39 00 00 00 00 00 02 FB 01
                        39 00 00 00 00 00 02 B3 80
                        39 01 00 00 00 00 02 B2 00
                        ];

                qcom,mdss-dsi-dispparam-pen-120hz-command = [
                        39 00 00 00 00 00 02 FF 10
                        39 00 00 00 00 00 02 FB 01
                        39 00 00 00 00 00 02 B3 40
                        39 01 00 00 00 00 02 B2 91
                        ];
                 qcom,mdss-dsi-dispparam-pen-60hz-command = [
                       39 00 00 00 00 00 02 FF 10
                       39 00 00 00 00 00 02 FB 01
                       39 00 00 00 00 00 02 B3 40
                       39 01 00 00 00 00 02 B2 91
                        ];
                 qcom,mdss-dsi-dispparam-pen-30hz-command = [
                        39 00 00 00 00 00 02 FF 10
                        39 00 00 00 00 00 02 FB 01
                        39 00 00 00 00 00 02 B3 80
                        39 01 00 00 00 00 02 B2 00
                        ];
                 qcom,mdss-dsi-dispparam-pen-90hz-command = [
                        39 00 00 00 00 00 02 FF 10
                        39 00 00 00 00 00 02 FB 01
                        39 00 00 00 00 00 02 B3 80
                        39 01 00 00 00 00 02 B2 00
                        ];
                mi,mdss-dsi-dispparam-pen-clear-command = [
                        39 00 00 00 00 00 02 FF 10
                        39 00 00 00 00 00 02 FB 01
                        39 01 00 00 00 00 02 B2 80
                        ];
                qcom,mdss-dsi-dispparam-pen-120hz-command-state = "dsi_lp_mode";
                qcom,mdss-dsi-dispparam-pen-60hz-command-state = "dsi_lp_mode";
                qcom,mdss-dsi-dispparam-pen-30hz-command-state = "dsi_lp_mode";
                qcom,mdss-dsi-dispparam-pen-144hz-command-state = "dsi_lp_mode";
                qcom,mdss-dsi-dispparam-pen-90hz-command-state = "dsi_lp_mode";
                qcom,mdss-dsi-dispparam-pen-48hz-command-state = "dsi_lp_mode";
                qcom,mdss-dsi-dispparam-pen-50hz-command-state = "dsi_lp_mode";
                mi,mdss-dsi-dispparam-pen-clear-command-state = "dsi_lp_mode";


                mi,mdss-dsi-lcd-hbm-l1-on-command = [
                        /* max brightness 80% */
                        15 01 00 00 00 00 02 FF 10
                        39 01 00 00 00 00 03 51 0F FF];
                mi,mdss-dsi-lcd-hbm-l1-on-command-state = "dsi_lp_mode";
                mi,mdss-dsi-lcd-hbm-l2-on-command = [
                        /* max brightness 85% */
                        15 01 00 00 00 00 02 FF 10
                        39 01 00 00 00 00 03 51 0F FF];
                mi,mdss-dsi-lcd-hbm-l2-on-command-state = "dsi_lp_mode";
                mi,mdss-dsi-lcd-hbm-l3-on-command = [
                        /* max brightness 91% */
                        15 01 00 00 00 00 02 FF 10
                        39 01 00 00 00 00 03 51 0F FF];
                mi,mdss-dsi-lcd-hbm-l3-on-command-state = "dsi_lp_mode";
                mi,mdss-dsi-lcd-hbm-off-command = [
                        15 01 00 00 00 00 02 FF 10
                        39 01 00 00 00 00 03 51 0F FF];
                mi,mdss-dsi-lcd-hbm-off-command-state = "dsi_lp_mode";
            };
        };
    };
};


&dsi_m82_42_02_0b_dual_dphy_video {
    mi,panel-id = <0x4D383241 0x00420200>;
    mi,feature-enabled;
    mi,is-tddi-flag;
    mi,mdss-panel-on-dimming-delay = <300>;
    mi,esd-err-irq-gpio = <&tlmm 51 0x2004>; /* trig-flags: falling-0x0002 rasing-0x0001*/
    mi,esd-err-irq-gpio-sec = <&tlmm 55 0x2004>; /* trig-flags: falling-0x0002 rasing-0x0001*/
    mi,mdss-dsi-panel-xy-coordinate = <0x6 0x18>;
    mi,mdss-dsi-panel-max-luminance = <0x6 0x4>;

    qcom,mdss-dsi-display-timings {
        timing@0{
            mi,mdss-dsi-read-lockdown-info-command = [
                15 01 00 00 00 00 02 FF 22
                15 01 00 00 00 00 02 FB 01
                06 01 00 00 00 00 01 00
                15 01 00 00 00 00 02 FF 10];
            mi,mdss-dsi-read-lockdown-info-command-state = "dsi_lp_mode";

            mi,mdss-dsi-cabcuion-command = [
                15 00 00 00 00 00 02 FF 10
                15 00 00 00 00 00 02 FB 01
                15 01 00 00 00 00 02 55 01
            ];
            mi,mdss-dsi-cabcstillon-command = [
                15 00 00 00 00 00 02 FF 10
                15 00 00 00 00 00 02 FB 01
                15 01 00 00 00 00 02 55 02
            ];
            mi,mdss-dsi-cabcmovieon-command = [
                15 00 00 00 00 00 02 FF 10
                15 00 00 00 00 00 02 FB 01
                15 01 00 00 00 00 02 55 03
            ];
            mi,mdss-dsi-cabcoff-command = [
                15 00 00 00 00 00 02 FF 10
                15 00 00 00 00 00 02 FB 01
                15 01 00 00 00 00 02 55 00
            ];
            mi,mdss-dsi-dimmingon-command = [
                /* ESD Detection Signal */
                15 01 00 00 00 00 02 FF 27
                15 01 00 00 00 00 02 FB 01
                15 01 00 00 00 00 02 D1 28
                /* CABC DIMMING ON */
                15 00 00 00 00 00 02 FF 10
                15 00 00 00 00 00 02 FB 01
                15 01 00 00 00 00 02 53 2C
            ];

            mi,mdss-dsi-cabcuion-command-state = "dsi_lp_mode";
            mi,mdss-dsi-cabcstillon-command-state = "dsi_lp_mode";
            mi,mdss-dsi-cabcmovieon-command-state = "dsi_lp_mode";
            mi,mdss-dsi-cabcoff-command-state = "dsi_lp_mode";
            mi,mdss-dsi-dimmingon-command-state = "dsi_lp_mode";

            mi,mdss-dsi-xy-coordinate-command = [
                15 01 00 00 00 00 02 FF 10
                06 01 00 00 00 00 01 A1];
            mi,mdss-dsi-xy-coordinate-command-state = "dsi_lp_mode";

            mi,mdss-dsi-max-luminance-write-command = [
                15 01 00 00 00 00 02 FF 10];
            mi,mdss-dsi-max-luminance-write-command-state = "dsi_lp_mode";
            mi,mdss-dsi-max-luminance-read-command = [
                06 01 00 00 00 00 01 A1];
            mi,mdss-dsi-max-luminance-read-command-state = "dsi_lp_mode";

            mi,mdss-dsi-disable-insert-black-command = [
                15 00 00 00 00 00 02 FF 10
                15 00 00 00 00 00 02 FB 01
                05 01 00 00 00 00 02 13 00];
            mi,mdss-dsi-disable-insert-black-command-state = "dsi_lp_mode";
            mi,mdss-dsi-insert-black-screen-command = [
                15 00 00 00 00 00 02 FF 10
                15 00 00 00 00 00 02 FB 01
                05 01 00 00 00 00 02 22 00];
            mi,mdss-dsi-insert-black-screen-command-state = "dsi_lp_mode";
        };
    };
};