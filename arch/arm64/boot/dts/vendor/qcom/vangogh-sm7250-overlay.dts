/dts-v1/;
/plugin/;

#include <dt-bindings/interrupt-controller/arm-gic.h>
#include "vangogh-sm7250.dtsi"
#include "vangogh-audio-overlay.dtsi"
#include "vangogh-sm7250-camera-sensor-mtp.dtsi"

/ {
	model = "Qualcomm Technologies, Inc. 7250 vangogh";
	compatible = "qcom,lito-mtp", "qcom,lito", "qcom,mtp";
	qcom,msm-id = <400 0x10000>;
	qcom,board-id = <35 0>;
};
