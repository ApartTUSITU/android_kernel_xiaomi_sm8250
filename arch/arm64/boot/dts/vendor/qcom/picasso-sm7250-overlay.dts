/dts-v1/;
/plugin/;

#include <dt-bindings/interrupt-controller/arm-gic.h>
#include "picasso-sm7250.dtsi"
#include "picasso-audio-overlay.dtsi"
#include "picasso-sm7250-camera-sensor-mtp.dtsi"

/ {
	model = "Qualcomm Technologies, Inc. 7250 picasso";
	compatible = "qcom,lito-mtp", "qcom,lito", "qcom,mtp";
	qcom,msm-id = <400 0x10000>;
	qcom,board-id = <36 0>;
};
