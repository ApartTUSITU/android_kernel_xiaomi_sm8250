/dts-v1/;

#include "lito.dtsi"
#include "vangogh-sm7250.dtsi"

/ {
	model = "Qualcomm Technologies, Inc. Vangogh";
	compatible = "qcom,lito-mtp", "qcom,lito", "qcom,mtp";
	qcom,board-id = <35 0>;
};
