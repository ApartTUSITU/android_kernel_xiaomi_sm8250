/* Copyright (c) 2015, The Linux Foundation. All rights reserved.
 *
 * This program is free software; you can redistribute it and/or modify
 * it under the terms of the GNU General Public License version 2 and
 * only version 2 as published by the Free Software Foundation.
 *
 * This program is distributed in the hope that it will be useful,
 * but WITHOUT ANY WARRANTY; without even the implied warranty of
 * MERCHANTABILITY or FITNESS FOR A PARTICULAR PURPOSE.  See the
 * GNU General Public License for more details.
 */

/*---------------------------------------------------------------------------
 * This file is autogenerated file using gcdb parser. Please do not edit it.
 * Update input XML file to add a new entry or update variable in this file
 * VERSION = "1.0"
 *---------------------------------------------------------------------------*/
&mdss_mdp {
    dsi_l81a_42_04_0a_dual_dphy_video: qcom,mdss_dsi_l81a_42_04_0a_dual_dphy_video {
        qcom,mdss-dsi-panel-name = "xiaomi 42 04 0a video mode dual dsi dphy panel";
        qcom,mdss-dsi-panel-id = <0>;
        qcom,mdss-dsi-panel-model = "xiaomi 42 04 0a VIDEO PANEL";
        qcom,mdss-dsi-panel-type = "dsi_video_mode";
        qcom,mdss-dsi-panel-count = <2>;
        qcom,mdss-dsi-stream = <0>;
        qcom,mdss-dsi-bpp = <24>;
        qcom,mdss-dsi-underflow-color = <0xff>;
        qcom,mdss-dsi-border-color = <0>;
        qcom,mdss-dsi-traffic-mode = "non_burst_sync_event";
        qcom,mdss-dsi-bllp-eof-power-mode;
        qcom,mdss-dsi-bllp-power-mode;
        qcom,mdss-dsi-pixel-packing = "loose";
        qcom,mdss-dsi-lp11-init;
        qcom,mdss-dsi-virtual-channel-id = <0>;
        qcom,mdss-dsi-color-order = "rgb_swap_rgb";
        qcom,mdss-dsi-lane-0-state;
        qcom,mdss-dsi-lane-1-state;
        qcom,mdss-dsi-lane-2-state;
        qcom,mdss-dsi-lane-3-state;
        qcom,mdss-dsi-interleave-mode = <0>;
        qcom,mdss-brightness-max-level = <2047>;
        mi,mdss-dsi-panel-max-brightness-clone = <4095>;
        qcom,mdss-dsi-dma-trigger = "trigger_sw";
        qcom,mdss-dsi-mdp-trigger = "none";
        qcom,mdss-dsi-reset-sequence = <0 1>, <1 1>, <0 1>, <1 55>;
        qcom,adjust-timer-wakeup-ms = <1>;
        qcom,mdss-pan-physical-width-dimension = <1662>;
        qcom,mdss-pan-physical-height-dimension = <2660>;
        qcom,mdss-dsi-panel-mode-gpio-state = "invalid";
        qcom,mdss-dsi-tx-eot-append;
        qcom,mdss-dsi-rx-eot-ignore;

        qcom,cmd-sync-wait-broadcast;
        qcom,mdss-dsi-panel-broadcast-mode;

        qcom,esd-check-enabled;
        qcom,mdss-dsi-panel-status-check-mode ="irq_check";
        qcom,mdss-dsi-panel-status-command = [06 01 00 00 00 00 01 0A];
        qcom,mdss-dsi-panel-status-command-state = "dsi_lp_mode";
        qcom,mdss-dsi-panel-status-value = <0x9D>;
        qcom,mdss-dsi-panel-status-read-length = <1>;

        qcom,bl-update-flag = "delay_until_first_frame";
        qcom,mdss-dsi-panel-hdr-enabled;
        qcom,mdss-dsi-panel-hdr-color-primaries = <14500 15500 32000
            17000 15500 30000 8000 3000>;
        qcom,mdss-dsi-panel-peak-brightness = <4200000>;
        qcom,mdss-dsi-panel-blackness-level = <3230>;

        qcom,mdss-dsi-pan-enable-dynamic-fps;
        qcom,mdss-dsi-pan-fps-update =
                "dfps_immediate_porch_mode_vfp";
        qcom,dsi-supported-dfps-list = <120 60>;

        qcom,mdss-dsi-display-timings {
            timing@0{
                qcom,mdss-dsi-panel-framerate = <120>;
                qcom,mdss-dsi-panel-width = <800>; // 1600/2
                qcom,mdss-dsi-panel-height = <2560>;
                qcom,mdss-dsi-h-pulse-width = <40>;
                qcom,mdss-dsi-h-back-porch = <60>;
                qcom,mdss-dsi-h-front-porch = <60>;
                qcom,mdss-dsi-h-sync-skew = <0>;
                qcom,mdss-dsi-v-pulse-width = <4>;
                qcom,mdss-dsi-v-back-porch = <18>;
                qcom,mdss-dsi-v-front-porch = <160>;
                qcom,mdss-dsi-h-left-border = <0>;
                qcom,mdss-dsi-h-right-border = <0>;
                qcom,mdss-dsi-v-top-border = <0>;
                qcom,mdss-dsi-v-bottom-border = <0>;

                qcom,mdss-dsi-on-command= [
                        39 01 00 00 00 00 06 B9 83 12 1A 55 00
                        39 01 00 00 00 00 02 BD 01
                        39 01 00 00 00 00 35 E2 46 06 0C BE 03 3F 0F 57 01 45 10 07 18 01 06 00 00 14 14 14 14 00 00 00 29 14 14 39 4C 1C 00 22 C9 02 02 00 00 93 01 0D 49 0E 4A 00 18 45 60 3E 00 05 7A 00
                        39 01 00 00 00 00 02 BD 00
                        39 01 00 00 00 00 02 D1 37
                        39 01 00 00 00 00 08 BF FD 00 80 9C 10 00 80
                        39 01 00 00 00 00 0E BA 70 03 A8 92 01 10 00 00 08 3D 02 77 84
                        39 01 00 00 00 00 03 D9 0C 0C
                        39 01 00 00 00 00 03 02 BD 00
                        39 01 00 00 00 00 12 B2 00 6A 40 00 00 14 9E 60 3C 02 80 21 21 00 00 10 27
                        /* CABC SETTING START*/
                        39 01 00 00 00 00 06 B9 83 12 1A 55 00
                        39 01 00 00 00 00 02 BD 03
                        39 01 00 00 00 00 25 E4 99 99 99 AA BB CC DD EE FF FF FF 03 99 99 99 FF 66 4A 99 C6 FF 55 FE 03 AD AD AD E5 1E 57 8F C8 FF AA FF 03
                        39 01 00 00 00 00 02 BD 01
                        39 01 00 00 00 00 28 E4 E1 E1 E1 E1 E1 E1 E1 E1 C7 B2 A0 90 81 75 69 5F 55 4C 44 3D 36 2F 2A 24 1E 19 14 10 0D 0C 0A 54 55 55 55 55 55 55 55
                        39 01 00 00 00 00 02 BD 00
                        /* CABC SETTING END*/
                        39 01 00 00 00 00 06 B9 00 00 00 00 00
                        39 01 00 00 00 00 02 35 00
                        39 01 00 00 00 00 03 51 0F FF
                        39 01 00 00 00 00 02 53 24
                        39 01 00 00 3E 00 01 11
                        39 01 00 00 14 00 01 29
                        ];
                qcom,mdss-dsi-off-command = [
                        05 01 00 00 00 00 02 28 00
                        05 01 00 00 46 00 02 10 00];
                qcom,mdss-dsi-displayoff-command = [05 01 00 00 20 00 02 28 00];
                qcom,mdss-dsi-displayon-command = [05 01 00 00 14 00 02 29 00];
                qcom,mdss-dsi-on-command-state = "dsi_lp_mode";
                qcom,mdss-dsi-off-command-state = "dsi_lp_mode";
                qcom,mdss-dsi-displayoff-command-state = "dsi_hs_mode";
                qcom,mdss-dsi-displayon-command-state = "dsi_hs_mode";

                qcom,compression-mode = "dsc";
                qcom,mdss-dsc-version = <0x11>;
                qcom,mdss-dsc-scr-version = <0x0>;
                qcom,mdss-dsc-slice-height = <20>;
                qcom,mdss-dsc-slice-width = <800>;
                qcom,mdss-dsc-slice-per-pkt = <1>;
                qcom,mdss-dsc-bit-per-component = <8>;
                qcom,mdss-dsc-bit-per-pixel = <8>;
                qcom,mdss-dsc-block-prediction-enable;

                qcom,mdss-dsi-dispparam-pen-120hz-command = [
                        39 00 00 00 00 00 06 B9 83 12 1A 55 00
                        39 00 00 00 00 00 02 BD 00
                        39 00 00 00 00 00 02 E2 00
                        39 00 00 00 00 00 02 D1 37
                        39 01 00 00 00 00 06 B9 00 00 00 00 00
                        ];
                qcom,mdss-dsi-dispparam-pen-60hz-command = [
                        39 00 00 00 00 00 06 B9 83 12 1A 55 00
                        39 00 00 00 00 00 02 BD 00
                        39 00 00 00 00 00 02 E2 10
                        39 00 00 00 00 00 02 D1 37
                        39 01 00 00 00 00 06 B9 00 00 00 00 00
                        ];
                qcom,mdss-dsi-dispparam-pen-120hz-command-state = "dsi_lp_mode";
                qcom,mdss-dsi-dispparam-pen-60hz-command-state = "dsi_lp_mode";
                qcom,mdss-dsi-dispparam-pen-30hz-command-state = "dsi_lp_mode";

                mi,mdss-dsi-lcd-hbm-l1-on-command = [
                        /* max brightness 80% */
                        15 01 00 00 00 00 02 FF 10
                        39 01 00 00 00 00 03 51 0F FF];
                mi,mdss-dsi-lcd-hbm-l1-on-command-state = "dsi_lp_mode";
                mi,mdss-dsi-lcd-hbm-l2-on-command = [
                        /* max brightness 85% */
                        15 01 00 00 00 00 02 FF 10
                        39 01 00 00 00 00 03 51 0F FF];
                mi,mdss-dsi-lcd-hbm-l2-on-command-state = "dsi_lp_mode";
                mi,mdss-dsi-lcd-hbm-l3-on-command = [
                        /* max brightness 91% */
                        15 01 00 00 00 00 02 FF 10
                        39 01 00 00 00 00 03 51 0F FF];
                mi,mdss-dsi-lcd-hbm-l3-on-command-state = "dsi_lp_mode";
                mi,mdss-dsi-lcd-hbm-off-command = [
                        15 01 00 00 00 00 02 FF 10
                        39 01 00 00 00 00 03 51 0F FF];
                mi,mdss-dsi-lcd-hbm-off-command-state = "dsi_lp_mode";
            };
        };
    };
};


&dsi_l81a_42_04_0a_dual_dphy_video {
    mi,panel-id = <0x4C383141 0x00420400>;
    mi,feature-enabled;
    mi,is-tddi-flag;
    mi,mdss-panel-on-dimming-delay = <300>;
    mi,esd-err-irq-gpio = <&tlmm 51 0x2008>; /* trig-flags: falling-0x0002 rasing-0x0001*/
    mi,mdss-dsi-panel-xy-coordinate = <0x6 0x18>;
    mi,mdss-dsi-panel-max-luminance = <0x6 0x4>;

    qcom,mdss-dsi-display-timings {
        timing@0{
            mi,mdss-dsi-read-lockdown-info-command = [
                15 01 00 00 00 00 02 FF 22
                06 01 00 00 00 00 01 01
                06 01 00 00 00 00 01 02
                06 01 00 00 00 00 01 03
                06 01 00 00 00 00 01 04
                06 01 00 00 00 00 01 05
                06 01 00 00 00 00 01 06
                06 01 00 00 00 00 01 07
                06 01 00 00 00 00 01 08
                15 01 00 00 00 00 02 FF 10];
            mi,mdss-dsi-read-lockdown-info-command-state = "dsi_lp_mode";

            mi,mdss-dsi-cabcuion-command = [
                15 01 00 00 00 00 02 55 01
            ];
            mi,mdss-dsi-cabcstillon-command = [
                15 01 00 00 00 00 02 55 02
            ];
            mi,mdss-dsi-cabcmovieon-command = [
                15 01 00 00 00 00 02 55 03
            ];
            mi,mdss-dsi-cabcoff-command = [
                15 00 00 00 00 00 02 B9 04
                15 00 00 00 00 00 02 55 00
                15 01 00 00 00 00 02 B9 02
            ];
            mi,mdss-dsi-dimmingon-command = [
                /* ESD Detection Signal */
                15 01 00 00 00 00 02 FF 27
                15 01 00 00 00 00 02 D1 28
                /* CABC DIMMING ON */
                15 01 00 00 00 00 02 FF 10
                15 01 00 00 00 00 02 53 2C
            ];

            mi,mdss-dsi-cabcuion-command-state = "dsi_lp_mode";
            mi,mdss-dsi-cabcstillon-command-state = "dsi_lp_mode";
            mi,mdss-dsi-cabcmovieon-command-state = "dsi_lp_mode";
            mi,mdss-dsi-cabcoff-command-state = "dsi_lp_mode";
            mi,mdss-dsi-dimmingon-command-state = "dsi_lp_mode";

            mi,mdss-dsi-xy-coordinate-command = [
                15 01 00 00 00 00 02 FF 10
                06 01 00 00 00 00 01 A1];
            mi,mdss-dsi-xy-coordinate-command-state = "dsi_lp_mode";

            mi,mdss-dsi-max-luminance-write-command = [
                15 01 00 00 00 00 02 FF 10];
            mi,mdss-dsi-max-luminance-write-command-state = "dsi_lp_mode";
            mi,mdss-dsi-max-luminance-read-command = [
                06 01 00 00 00 00 01 A1];
            mi,mdss-dsi-max-luminance-read-command-state = "dsi_lp_mode";

            mi,mdss-dsi-disable-insert-black-command = [
                39 01 00 00 00 00 06 B9 83 12 1A 55 00
                39 01 00 00 00 00 02 13 00
                39 01 00 00 00 00 06 B9 00 00 00 00 00];
            mi,mdss-dsi-disable-insert-black-command-state = "dsi_lp_mode";
            mi,mdss-dsi-insert-black-screen-command = [
                39 01 00 00 00 00 06 B9 83 12 1A 55 00
                39 01 00 00 00 00 02 22 00
                39 01 00 00 00 00 06 B9 00 00 00 00 00];
            mi,mdss-dsi-insert-black-screen-command-state = "dsi_lp_mode";
        };
    };
};
