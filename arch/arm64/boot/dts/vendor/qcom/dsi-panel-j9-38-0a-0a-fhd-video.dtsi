/* Copyright (c) 2019, The Linux Foundation. All rights reserved.
 * Copyright (C) 2021 XiaoMi, Inc.
 *
 * This program is free software; you can redistribute it and/or modify
 * it under the terms of the GNU General Public License version 2 and
 * only version 2 as published by the Free Software Foundation.
 *
 * This program is distributed in the hope that it will be useful,
 * but WITHOUT ANY WARRANTY; without even the implied warranty of
 * MERCHANTABILITY or FITNESS FOR A PARTICULAR PURPOSE.  See the
 * GNU General Public License for more details.
 */

/*---------------------------------------------------------------------------
 * This file is autogenerated file using gcdb parser. Please do not edit it.
 * Update input XML file to add a new entry or update variable in this file
 * VERSION = "1.0"
 *---------------------------------------------------------------------------*/
&mdss_mdp {
	dsi_j9_38_0a_0a_video: qcom,mdss_dsi_j9_38_0a_0a_fhd_video {
		qcom,mdss-dsi-panel-name = "xiaomi 38 0a 0a video mode fhd dsi panel";
		qcom,mdss-dsi-panel-id = <0>;
		qcom,mdss-dsi-panel-model = "xiaomi 38 0a 0a VIDEO PANEL";
		qcom,mdss-dsi-panel-type = "dsi_video_mode";
		qcom,dsi-ctrl-num = <0>;
		qcom,dsi-phy-num = <0>;
		qcom,dsi-select-clocks = "mux_byte_clk0", "mux_pixel_clk0",
			"src_byte_clk0", "src_pixel_clk0",
			"shadow_byte_clk0", "shadow_pixel_clk0";
		qcom,mdss-dsi-virtual-channel-id = <0>;
		qcom,mdss-dsi-stream = <0>;
		qcom,mdss-dsi-bpp = <24>;
		qcom,mdss-dsi-color-order = "rgb_swap_rgb";
		qcom,mdss-dsi-underflow-color = <0xff>;
		qcom,mdss-dsi-border-color = <0>;
		qcom,mdss-dsi-traffic-mode = "burst_mode";
		qcom,mdss-dsi-bllp-eof-power-mode;
		qcom,mdss-dsi-bllp-power-mode;
		qcom,mdss-dsi-lp11-init;
		qcom.mdss-dsi-lane-map = "lane_map_0123";
		qcom,mdss-dsi-lane-0-state;
		qcom,mdss-dsi-lane-1-state;
		qcom,mdss-dsi-lane-2-state;
		qcom,mdss-dsi-lane-3-state;
		qcom,mdss-dsi-dma-trigger = "trigger_sw";
		qcom,mdss-dsi-mdp-trigger = "none";
		qcom,mdss-dsi-reset-sequence = <0 1>, <1 5>;
		qcom,mdss-pan-physical-width-dimension = <69>;
		qcom,mdss-pan-physical-height-dimension = <153>;
		qcom,mdss-dsi-wr-mem-start = <0x2c>;
		qcom,mdss-dsi-wr-mem-continue = <0x3c>;
		qcom,mdss-dsi-tx-eot-append;
		qcom,bl-update-flag = "delay_until_first_frame";
		qcom,mdss-dsi-panel-hdr-enabled;
		qcom,mdss-dsi-panel-hdr-color-primaries = <14500 15500 32000
			17000 15500 30000 8000 3000>;
		qcom,mdss-dsi-panel-peak-brightness = <4200000>;
		qcom,mdss-dsi-panel-blackness-level = <3230>;
		qcom,mdss-dsi-panel-xy-coordinate = <0x0F 0x18>;
		qcom,mdss-dsi-panel-max-luminance = <0x0F 0x20>;
		qcom,mdss-dsi-panel-max-luminance-valid = <0x01 0x01>;
		qcom,dsi-dyn-clk-enable;
		qcom,dsi-dyn-clk-list = <1106657280 1096282368>;

		qcom,mdss-dsi-display-timings {
			timing@0{
				qcom,mdss-dsi-panel-framerate = <60>;
				qcom,mdss-dsi-panel-width = <1080>;
				qcom,mdss-dsi-panel-height = <2400>;
				qcom,mdss-dsi-h-pulse-width = <16>;
				qcom,mdss-dsi-h-back-porch = <68>;
				qcom,mdss-dsi-h-front-porch = <100>;
				qcom,mdss-dsi-h-sync-skew = <0>;
				qcom,mdss-dsi-h-sync-pluse = <1>;
				qcom,mdss-dsi-v-pulse-width = <4>;
				qcom,mdss-dsi-v-back-porch = <7>;
				qcom,mdss-dsi-v-front-porch = <21>;
				qcom,mdss-dsi-h-left-border = <0>;
				qcom,mdss-dsi-h-right-border = <0>;
				qcom,mdss-dsi-v-top-border = <0>;
				qcom,mdss-dsi-v-bottom-border = <0>;

				qcom,mdss-dsi-post-panel-on-command = [
						05 01 00 00 14 00 02 11 00
						39 00 00 00 00 00 02 35 00
						/* FAIL SAFE Setting */
						39 00 00 00 00 00 03 FC 5A 5A
						39 00 00 00 00 00 03 B0 03 ED
						39 00 00 00 00 00 0A ED 40 04 08 A8 84 4A 73 02 0A
						39 00 00 00 00 00 04 ED 01 CD 00
						39 00 00 00 00 00 02 E1 93
						39 00 00 00 00 00 03 FC A5 A5
						/* OFC Setting */
						39 00 00 00 00 00 03 FC 5A 5A
						39 00 00 00 00 00 16 DF 09 30 95 43 3B 05 00 27 50 2E 4F 7A 77 10 3D 73 00 FF 01 8B 08
						39 00 00 00 00 00 03 FC A5 A5
						/* Brightness Control */
						39 00 00 00 00 00 03 F0 5A 5A
						39 00 00 00 00 00 02 B0 03
						39 00 00 00 00 00 02 CD 04
						39 00 00 00 00 00 03 B0 06 B3
						39 00 00 00 00 00 02 B3 10
						39 00 00 00 00 00 03 B0 04 B3
						39 00 00 00 00 00 02 B3 C0
						39 00 00 00 00 00 03 B0 05 B3
						39 00 00 00 00 00 02 B3 93
						39 00 00 00 00 00 03 B3 11 4B
						39 00 00 00 00 00 03 F0 A5 A5
						39 00 00 00 00 00 02 53 20
						39 00 00 00 00 00 03 51 00 00
						39 00 00 00 00 00 02 55 00
						39 00 00 00 00 00 03 F0 5A 5A
						39 00 00 00 00 00 03 B0 B1 B5
						39 00 00 00 00 00 02 B5 00
						39 01 00 00 64 00 03 F0 A5 A5
						05 01 00 00 00 00 02 29 00
				];

				qcom,mdss-dsi-pre-off-command = [
						05 00 00 00 00 00 02 28 00
						05 01 00 00 96 00 02 10 00];
				qcom,mdss-dsi-displayoff-command = [05 01 00 00 20 00 02 28 00];
				qcom,mdss-dsi-displayon-command = [05 01 00 00 14 00 02 29 00];
				qcom,mdss-dsi-nolp-command = [39 01 00 00 00 00 03 51 00 00];
				qcom,mdss-dsi-on-command-state = "dsi_lp_mode";
				qcom,mdss-dsi-post-on-command-state = "dsi_hs_mode";
				qcom,mdss-dsi-pre-off-command-state = "dsi_hs_mode";
				qcom,mdss-dsi-displayoff-command-state = "dsi_hs_mode";
				qcom,mdss-dsi-displayon-command-state = "dsi_hs_mode";
				qcom,mdss-dsi-nolp-command-state = "dsi_hs_mode";

			};
		};
	};
};

&dsi_j9_38_0a_0a_video {
	mi,feature-enabled;
	/* enable fod feature */
	mi,mdss-dsi-panel-fod-dimlayer-enabled;
	mi,mdss-dsi-bl-dcs-big-endian-type;
	mi,mdss-dsi-panel-hbm-51-ctrl-flag;
	mi,mdss-dsi-panel-hbm-off-51-index = <1>;
	mi,mdss-dsi-panel-fod-off-51-index = <1>;
	/* IRQF_ONESHOT | IRQF_TRIGGER_FALLING */
	/* trig-flags: falling-0x0002 rasing-0x0001 */
	mi,esd-err-irq-gpio = <&tlmm 55 0x2002>;
	mi,mdss-panel-on-dimming-enable;
	mi,mdss-panel-on-dimming-delay = <120>;
	mi,disp-fod-off-dimming-delay = <85>;

	// mi,elvss_dimming_check_enable;
	mi,mdss-dsi-elvss-dimming-register-read-length = <1>;
	mi,mdss-dsi-elvss-dimming-update-hbm-fod-on-index = <4>;
	mi,mdss-dsi-elvss-dimming-update-hbm-fod-off-index = <7>;
	mi,mdss-dsi-panel-dc-on-hs-enable;
	mi,mdss-dsi-panel-dc-threshold = <538>;
	mi,mdss-dsi-panel-dc-type = <1>;

	/* enable nolp command set backlight */
	qcom,mdss-dsi-nolp-command-set-backlight-enabled;

	/* AOD brightness setting */
	mi,mdss-dsi-doze-hbm-brightness-value = <270>;
	mi,mdss-dsi-doze-lbm-brightness-value = <20>;

	mi,mdss-dsi-panel-fod-dimlayer-enabled;
	mi,mdss-panel-fod-hbm-on-need-prepare;
	mi,mdss-panel-fod-hbm-off-delay;
	mi,mdss-dsi-dimlayer-brightness-alpha-lut-item-count = <21>;
	mi,mdss-dsi-dimlayer-brightness-alpha-lut =
	/* brightness  alpha */
		<0          0xFF
		 4          0xEB
		 8          0xEA
		 12         0xE9
		 13         0xE8
		 20         0xE5
		 24         0xE3
		 30         0xE0
		 68         0xD0
		 133        0xC0
		 218        0xB0
		 328        0xA0
		 486        0x90
		 642        0x80
		 832        0x70
		 1043       0x60
		 1267       0x50
		 1500       0x40
		 1770       0x30
		 2000       0x24
		 2047       0x21>;

	qcom,mdss-dsi-display-timings {
		timing@0{
			mi,mdss-dsi-doze-hbm-command = [
				39 01 00 00 00 00 03 51 01 0E
			];
			mi,mdss-dsi-doze-lbm-command = [
				39 01 00 00 00 00 03 51 00 14
			];
			mi,mdss-dsi-doze-hbm-command-state = "dsi_lp_mode";
			mi,mdss-dsi-doze-lbm-command-state = "dsi_lp_mode";

			mi,mdss-dsi-hbm-fod-on-command = [
				/* ELVSS dimming off */
				39 00 00 00 00 00 03 F0 5A 5A
				39 00 00 00 00 00 03 B0 05 B3
				39 00 00 00 00 00 02 B3 13
				39 00 00 00 00 00 03 F0 A5 A5
				/* HBM ON 600nit */
				39 00 00 00 00 00 03 51 03 FF
				39 01 00 00 00 00 02 53 E0];
			mi,mdss-dsi-hbm-fod-on-command-state = "dsi_lp_mode";
			mi,mdss-dsi-hbm-fod-off-command = [
				15 00 00 00 00 00 02 53 20
				39 01 00 00 00 00 03 51 03 FF];
			mi,mdss-dsi-hbm-fod-off-command-state = "dsi_hs_mode";

			mi,mdss-dsi-hbm-off-command = [
				15 00 00 00 00 00 02 53 28
				/* parameter will be updated base on last brightness */
				39 01 00 00 00 00 03 51 03 FF];
			mi,mdss-dsi-hbm-off-command-state = "dsi_lp_mode";
			mi,mdss-dsi-hbm-on-command = [
				15 01 00 00 00 00 02 53 E8
				/* HBM ON 700nit */
				39 01 00 00 00 00 03 51 03 FF];
			mi,mdss-dsi-hbm-on-command-state = "dsi_lp_mode";

			mi,mdss-dsi-flat-on-command = [
				/* Level2 key enable */
				39 00 00 00 00 00 03 F0 5A 5A
				/* Flat mode on */
				39 00 00 00 00 00 03 B0 01 B8
				39 00 00 00 00 00 02 B8 29
				/* Level2 key disable */
				39 01 00 00 00 00 03 F0 A5 A5];
			mi,mdss-dsi-flat-off-command = [
				/* Level2 key enable */
				39 00 00 00 00 00 03 F0 5A 5A
				/* Flat mode off */
				39 00 00 00 00 00 03 B0 01 B8
				39 00 00 00 00 00 02 B8 09
				/* Level2 key disable */
				39 01 00 00 00 00 03 F0 A5 A5];
			mi,mdss-dsi-flat-on-command-state = "dsi_hs_mode";
			mi,mdss-dsi-flat-off-command-state = "dsi_hs_mode";

			mi,mdss-dsi-dimmingon-command = [39 01 00 00 01 00 02 53 28];
			mi,mdss-dsi-dimmingon-command-state = "dsi_hs_mode";
			mi,mdss-dsi-dimmingoff-command = [
				39 01 00 00 00 00 02 53 20];
			mi,mdss-dsi-dimmingoff-command-state = "dsi_hs_mode";

			mi,mdss-dsi-elvss-dimming-offset-command = [39 01 00 00 00 00 02 B0 07];
			mi,mdss-dsi-elvss-dimming-offset-command-state = "dsi_hs_mode";
			mi,mdss-dsi-elvss-dimming-read-command = [06 01 00 01 00 00 01 B7];
			mi,mdss-dsi-elvss-dimming-read-command-state = "dsi_hs_mode";
			mi,mdss-dsi-elvss-dimming-off-command = [
				39 00 00 00 00 00 03 F0 5A 5A
				39 00 00 00 00 00 02 B0 07
				39 00 00 00 00 00 02 B7 91
				39 01 00 00 01 00 03 F0 A5 A5];
			mi,mdss-dsi-elvss-dimming-off-command-state = "dsi_lp_mode";

			mi,mdss-dsi-acl-off-command = [39 01 00 00 00 00 02 55 00];
			mi,mdss-dsi-acl-off-command-state = "dsi_lp_mode";
			mi,mdss-dsi-acl-l1-command = [39 01 00 00 00 00 02 55 01];/* 50% */
			mi,mdss-dsi-acl-l1-command-state = "dsi_lp_mode";
			mi,mdss-dsi-acl-l2-command = [39 01 00 00 00 00 02 55 02];/* 40% */
			mi,mdss-dsi-acl-l2-command-state = "dsi_lp_mode";
			mi,mdss-dsi-acl-l3-command = [39 01 00 00 00 00 02 55 03];/* 30% */
			mi,mdss-dsi-acl-l3-command-state = "dsi_lp_mode";

			mi,mdss-dsi-crc-srgb-command = [
				/* CRC Enable + sRGB mode */
				39 01 00 00 00 00 02 81 90
				39 01 00 00 00 00 03 F0 5A 5A
				/* CRC Enable */
				39 01 00 00 00 00 02 B1 00
				/* Set Offset P2*/
				39 01 00 00 00 00 02 B0 01
				/* CRC LUT(sRGB mode) */
				39 01 00 00 00 00 16 B1 AE 0C 05 3F C6 14 05 07 AA 4A DD C8 C3 14 C0 E8 DC 19 FF F4 D9
				/* Set Offset P23*/
				39 01 00 00 00 00 02 B0 16
				/* CRC LUT(DCI-P3 mode) */
				39 01 00 00 00 00 16 B1 BD 02 00 14 D1 00 04 07 AA 0C EC CB C8 0F DD D9 E4 05 FF FF FF
				39 01 00 00 00 00 03 F0 A5 A5];
			mi,mdss-dsi-crc-srgb-command-state = "dsi_lp_mode";
			mi,mdss-dsi-crc-dcip3-command = [
				/* CRC Enable + DCI-P3 mode */
				39 01 00 00 00 00 02 81 91
				39 01 00 00 00 00 03 F0 5A 5A
				/* CRC Enable */
				39 01 00 00 00 00 02 B1 00
				/* Set Offset P2*/
				39 01 00 00 00 00 02 B0 01
				/* CRC LUT(sRGB mode) */
				39 01 00 00 00 00 16 B1 AE 0C 05 3F C6 14 05 07 AA 4A DD C8 C3 14 C0 E8 DC 19 FF F4 D9
				/* Set Offset P23*/
				39 01 00 00 00 00 02 B0 16
				/* CRC LUT(DCI-P3 mode) */
				39 01 00 00 00 00 16 B1 D2 0A 05 1A E6 00 04 07 F5 0C DC DB E8 0F DD EE E9 05 FF FF FF
				39 01 00 00 00 00 03 F0 A5 A5];
			mi,mdss-dsi-crc-dcip3-command-state = "dsi_lp_mode";
			mi,mdss-dsi-crc-off-command = [
				/* CRC Disable (Normal mode) */
				39 00 00 00 00 00 03 F0 5A 5A
				39 00 00 00 00 00 02 80 01
				/* CRC Bypass */
				39 00 00 00 00 00 02 B1 01
				39 01 00 00 00 00 03 F0 A5 A5];
			mi,mdss-dsi-crc-off-command-state = "dsi_hs_mode";
		};
	};
};
