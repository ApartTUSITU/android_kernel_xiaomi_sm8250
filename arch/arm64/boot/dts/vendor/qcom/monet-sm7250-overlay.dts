/dts-v1/;
/plugin/;

#include <dt-bindings/interrupt-controller/arm-gic.h>
#include "monet-sm7250.dtsi"
#include "monet-audio-overlay.dtsi"
#include "monet-sm7250-camera-sensor-mtp.dtsi"

/ {
	model = "Qualcomm Technologies, Inc. 7250 monet";
	compatible = "qcom,lito-mtp", "qcom,lito", "qcom,mtp";
	qcom,msm-id = <400 0x10000>;
	qcom,board-id = <37 0>;
};
