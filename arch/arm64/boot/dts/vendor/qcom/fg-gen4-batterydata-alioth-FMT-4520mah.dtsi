
qcom,04908437_xiaomi_k11_4520mah_averaged_masterslave_nov9th2020 {
	qcom,profile-revision = <24>;
	/* #04908437_Xiaomi_K11_4520mah_averaged_MasterSlave_Nov9th2020*/
	qcom,max-voltage-uv = <4480000>;
	qcom,fastchg-current-ma = <6000>;
	qcom,jeita-fcc-ranges = <(-100)  0   442000
				1  50  884000
				51  100  2210000
				101 150  3536000
				151 480  6000000
				481 580  2210000>;
	qcom,jeita-fv-ranges = <(-100)  0   4450000
				1   50  4450000
				51  100  4450000
				101 150  4450000
				151 480  4480000
				481 580  4100000>;
	qcom,jeita-too-hot = <580>;
	qcom,jeita-too-cold = <(-100)>;
	qcom,jeita-warm-th= <480>;
	qcom,jeita-cool-th= <150>;
	qcom,use-bq-pump;
	mi,six-pin-battery;
	qcom,ffc-term-current-ma = <(-755)>;
	qcom,fg-cc-cv-threshold-mv = <4440>;
	qcom,fg-ffc-cc-cv-threshold-mv = <4490>;
	qcom,nom-batt-capacity-mah = <4520>;
	qcom,batt-id-kohm = <100>;
	qcom,battery-beta = <4250>;
	qcom,therm-room-temp = <100000>;
	qcom,battery-type = "K11A_FMT_4520mah";
	qcom,therm-coefficients = <0x2318 0xd0c 0xdaf7 0xc556 0x848d>;
	qcom,therm-center-offset = <0x70>;
	qcom,therm-pull-up = <100>;
	qcom,rslow-normal-coeffs = <0x7f 0x07 0x89 0x12>;
	qcom,rslow-low-coeffs = <0x0f 0xea 0x8a 0x12>;
	qcom,checksum = <0x7EF5>;
	qcom,gui-version = "PM855GUI - 1.0.0.14";
	qcom,fg-profile-data = [
		 09 00 7B E2
		 C1 DD 26 E2
		 92 DD 00 00
		 E0 B4 8B 83
		 FB 87 A4 83
		 B6 95 1B 80
		 18 00 7F 07
		 89 12 7D 05
		 DD FA CE 07
		 32 00 12 E3
		 24 E4 B4 E2
		 72 0A 14 CA
		 53 B5 F5 22
		 CA 03 B7 C5
		 60 00 42 00
		 44 00 35 00
		 2F 00 31 00
		 3D 00 42 00
		 40 00 43 00
		 3B 00 60 00
		 41 00 3D 00
		 5A 00 4D 00
		 42 00 91 00
		 5F 64 4E 00
		 47 00 48 08
		 60 00 56 00
		 5A 08 77 10
		 69 10 59 00
		 B3 28 78 48
		 62 58 56 0E
		 58 00 D8 08
		 3B 20 50 14
		 F1 0B A2 04
		 3D 1C 0C 02
		 EB 04 89 2B
		 3C 17 46 42
		 87 5D BF 03
		 62 12 7C 22
		 09 15 BB 12
		 A3 0D ED 1C
		 AB 01 14 FD
		 AE FB 9D 16
		 28 2A 40 44
		 38 52 8C 13
		 17 26 B2 E5
		 B8 CB DC CC
		 F7 1C 3A C1
		 C3 05 B7 B3
		 85 16 06 82
		 BE 84 91 9B
		 A7 A0 09 80
		 4E 02 26 05
		 4D 03 E1 F5
		 00 F8 3D CD
		 13 03 FC 07
		 60 03 EB CD
		 1E 18 16 00
		 C0 05 F6 02
		 59 06 FA 02
		 CE 07 32 00
		 13 03 A9 04
		 EE 07 2D 03
		 AC 07 6D 02
		 77 03 19 03
		 CE 07 46 00
		 39 00 44 00
		 44 64 45 00
		 4B 08 42 10
		 42 00 46 00
		 46 00 33 10
		 3A 10 40 00
		 56 20 53 40
		 5A 58 6C 0F
		 48 00 4F 08
		 58 10 54 00
		 3D 00 4C 00
		 47 08 59 10
		 4D 00 5D 20
		 76 40 46 50
		 55 11 5A 00
		 4D 08 30 10
		 D8 08 2D 21
		 F0 FD 02 02
		 AA 04 BA 1C
		 65 23 C4 45
		 5B 52 5F 18
		 B3 03 40 04
		 A7 02 71 13
		 3F 0A 15 21
		 D6 05 32 02
		 2C 04 CE 1C
		 DF 02 4D 04
		 12 02 69 18
		 32 03 38 05
		 5F 03 72 00
		 C2 23 71 04
		 24 03 42 05
		 FB 1C 85 03
		 0B 05 8C 03
		 63 18 F1 02
		 AB 05 8B 02
		 92 00 C7 00
		 C0 00 FA 00
		 A1 11 00 00
	];
};
